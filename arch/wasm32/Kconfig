## arch/wasm32/Kconfig
```kconfig
# https://www.kernel.org/doc/html/next/kbuild/kconfig-language.html

config WASM32
       def_bool y
       depends on !SMP && !MMU && !COREDUMP && !SECCOMP && !UPROBES && !COMPAT && !USER_RETURN_NOTIFIER && !64BIT
       select ARCH_THREAD_STACK_ALLOCATOR
       select RWSEM_GENERIC_SPINLOCK
       select GENERIC_ATOMIC64
       select GENERIC_HWEIGHT
       select FLATMEM
       select FLAT_NODE_MEM_MAP
       select GENERIC_CLOCKEVENTS
       select GENERIC_CPU_DEVICES
       select NO_HZ_IDLE
       select NO_PREEMPT
       select HAS_DMA
       select DMA_OPS
       select HIGH_RES_TIMERS
       select ARCH_NO_COHERENT_DMA_MMAP
       select HAVE_MEMBLOCK
       select NO_BOOTMEM
       select UACCESS_MEMCPY
       select GENERIC_STRNCPY_FROM_USER
       select GENERIC_STRNLEN_USER


config OUTPUT_FORMAT
       string "Output format"
       default "wasm-wasm32"

config ARCH_DMA_ADDR_T_64BIT
       def_bool 64BIT

config PHYS_ADDR_T_64BIT
       def_bool 64BIT

config 64BIT
       bool "64bit kernel"
       default n

config COREDUMP
       def_bool n

config BIG_ENDIAN
       def_bool n

config CPU_BIG_ENDIAN
       def_bool BIG_ENDIAN

config GENERIC_CSUM
       def_bool y

config GENERIC_HWEIGHT
       def_bool y

config NO_IOPORT_MAP
       def_bool y

config RWSEM_GENERIC_SPINLOCK
	bool
	default y

config HZ
    int
    default 100

config CONSOLE_LOGLEVEL_QUIET
	int "quiet console loglevel (1-15)"
	range 1 15
	default "4"
	help
	  loglevel to use when "quiet" is passed on the kernel commandline.

	  When "quiet" is passed on the kernel commandline this loglevel
	  will be used as the loglevel. IOW passing "quiet" will be the
	  equivalent of passing "loglevel=<CONSOLE_LOGLEVEL_QUIET>"

config PCI
	bool "PCI support"
	select NO_GENERIC_PCI_IOPORT_MAP
	select GENERIC_PCI_IOMAP
	default n

config RAID6_PQ_BENCHMARK
	bool
	default n

config STACKTRACE_SUPPORT
    def_bool n

config BUILTIN_CMDLINE
	string "Built-in kernel command string"
	default ""
	help
	  Enter arguments here that should be compiled into the kernel
	  image and used at boot time. The command line provided to
	  lkl_start_kernel is appended to this string to form the full
	  command line.
```

## arch/wasm32/configs/wasm32_defconfig
```kconfig
CONFIG_OUTPUT_FORMAT=wasm-wasm32
CONFIG_64BIT=n
CONFIG_PCI=n
CONFIG_NO_HZ_IDLE=y
CONFIG_KALLSYMS_ALL=y
CONFIG_KALLSYMS_USE_DATA_SECTION=y
CONFIG_EMBEDDED=y
CONFIG_BINFMT_SCRIPT=n
CONFIG_MODVERSIONS=n
CONFIG_KALLSYMS=n
CONFIG_MODULES=n
```
